## conf/layer.conf
```bitbake
# We have a conf and classes directory, add to BBPATH
BBPATH .= ":${LAYERDIR}"

# We have recipes-* directories, add to BBFILES
BBFILES += "${LAYERDIR}/recipes-*/*/*.bb \
	${LAYERDIR}/recipes-*/*/*.bbappend"

BBFILE_COLLECTIONS += "ad-datacard"
BBFILE_PATTERN_ad-datacard = "^${LAYERDIR}/"
BBFILE_PRIORITY_ad-datacard = "6"

LAYERSERIES_COMPAT_ad-datacard = "thud"
```
